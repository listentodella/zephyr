## drivers/sensor/qst/qmi8660/Kconfig
```kconfig
# QST QMI8660 6-axis IMU driver configuration options
#
# SPDX-FileCopyrightText: Copyright The Zephyr Project Contributors
# SPDX-License-Identifier: Apache-2.0

menuconfig QMI8660
	bool "QST QMI8660 6-axis IMU"
	default y
	depends on DT_HAS_QST_QMI8660_ENABLED
	help
	  Enable driver for the QST QMI8660 six-axis IMU.

if QMI8660

config QMI8660_DECODER
	bool "QMI8660 decoder logic"
	default y
	select SENSOR_ASYNC_API
	help
	  Compile the QMI8660 decoder API which allows decoding raw data returned
	  from the sensor.

choice
	prompt "Trigger mode"
	default QMI8660_TRIGGER_NONE if QMI8660_STREAM
	default QMI8660_TRIGGER_GLOBAL_THREAD
	help
	  Specify the type of triggering to be used by the driver.

config QMI8660_TRIGGER_NONE
	bool "No trigger"

config QMI8660_TRIGGER_GLOBAL_THREAD
	bool "Use global thread"
	depends on GPIO
	depends on $(dt_compat_any_has_prop,$(DT_COMPAT_QST_QMI8660),int-gpios)
	select QMI8660_TRIGGER

config QMI8660_TRIGGER_OWN_THREAD
	bool "Use own thread"
	depends on GPIO
	depends on $(dt_compat_any_has_prop,$(DT_COMPAT_QST_QMI8660),int-gpios)
	select QMI8660_TRIGGER

endchoice

config QMI8660_STREAM
	bool "Use hardware FIFO to stream data"
	select QMI8660_TRIGGER
	default y
	depends on (SPI_RTIO || I2C_RTIO)
	depends on SENSOR_ASYNC_API
	help
	  Use this config option to enable streaming sensor data via RTIO subsystem.

config QMI8660_TRIGGER
	bool

config QMI8660_THREAD_PRIORITY
	int "Thread priority"
	depends on QMI8660_TRIGGER_OWN_THREAD
	default 10
	help
	  Priority of thread used by the driver to handle interrupts.

config QMI8660_THREAD_STACK_SIZE
	int "Thread stack size"
	depends on QMI8660_TRIGGER_OWN_THREAD
	default 1024
	help
	  Stack size of thread used by the driver to handle interrupts.

endif # QMI8660
```

## dts/bindings/sensor/qst,qmi8660-i2c.yaml
```yaml
description: |
  QST QMI8660 6-axis IMU (Inertial Measurement Unit) sensor
  accessed through I2C bus

compatible: "qst,qmi8660"

include: ["i2c-device.yaml", "qst,qmi8660.yaml"]
```

## dts/bindings/sensor/qst,qmi8660-spi.yaml
```yaml
description: |
  QST QMI8660 6-axis IMU (Inertial Measurement Unit) sensor
  accessed through SPI bus

compatible: "qst,qmi8660"

include: ["spi-device.yaml", "qst,qmi8660.yaml"]
```

## dts/bindings/sensor/qst,qmi8660.yaml
```yaml
# SPDX-FileCopyrightText: Copyright The Zephyr Project Contributors
# SPDX-License-Identifier: Apache-2.0

description: QST QMI8660 6-axis IMU

compatible: "qst,qmi8660"

include: [sensor-device.yaml]

properties:
  friendly-name:
    type: string
    description: |
      Human readable string describing the sensor. It can be used to
      distinguish multiple instances of the same model (e.g., lid accelerometer
      vs. base accelerometer in a laptop) to a host operating system.
  int-gpios:
    type: phandle-array
    description: |
      Data-ready interrupt line connected to the sensor INT1 or INT2 pin.
      Configure flags to match the signal level presented to the MCU.

  int-pin:
    type: int
    default: 1
    description: |
      Sensor interrupt pin to use for data-ready: 1 for INT1, 2 for INT2.
    enum:
      - 1
      - 2

  accel-fs:
    type: int
    default: 4
    description: |
      Accelerometer full-scale range in g.
      The default is a general-purpose range that balances resolution with
      headroom for typical handheld and board-level motion. Use 2 for highest
      sensitivity at low acceleration, or 8/16 when higher acceleration is
      expected.
    enum:
      - 4
      - 8
      - 16
      - 32

  gyro-fs:
    type: int
    default: 512
    description: |
      Gyroscope full-scale range in degrees per second (dps).
      The default provides a practical balance between sensitivity and headroom
      for common motion-tracking use. Use lower ranges for finer low-rate
      motion, or higher ranges for faster rotational movement.
    enum:
      - 128
      - 256
      - 512
      - 1024
      - 2048

  accel-odr-hz:
    type: int
    default: 50
    description: |
      Requested accelerometer output data rate in Hz.
      The default targets low-latency 6-DoF streaming and is paired with the
      gyroscope default to keep both sensors at the same nominal rate. Use
      lower values to reduce power and bandwidth, or higher values when maximum
      update rate is needed.

  gyro-odr-hz:
    type: int
    default: 50
    description: |
      Requested gyroscope output data rate in Hz.
      The default matches the accelerometer default to keep sampling rates
      aligned for fused 6-DoF data. Use lower values to reduce power and
      bandwidth, or higher values when faster gyro updates are required.

examples:
  - |
    #include <zephyr/dt-bindings/gpio.h>

    qmi8660@6b {
      compatible = "qst,qmi8660";
      friendly-name = "imu_mainboard";
      reg = <0x6b>;
      accel-fs = <4>;
      gyro-fs = <512>;
      accel-odr-hz = <50>;
      gyro-odr-hz = <50>;
      int-gpios = <&gpiob 10 GPIO_ACTIVE_HIGH>;
      int-pin = <2>;
    };
```
